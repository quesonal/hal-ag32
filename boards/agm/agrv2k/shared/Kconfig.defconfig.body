## boards/agm/agrv2k_103/board.yml
```yaml
board:
  name: agrv2k_103
  full_name: "AGM AgRV2K 103 (L100, 256 KB flash)"
  vendor: agm
  socs:
    - name: agrv2k
      variants:
        - name: agrv2k
```

## boards/agm/agrv2k_303/Kconfig.agrv2k_303
```kconfig
# AGM AgRV2K 303 board selection.
#
# Copyright (c) 2026 AgRV Contributors
# SPDX-License-Identifier: Apache-2.0

config BOARD_AGM_AGRV2K_303
	bool "AGM AgRV2K 303 (L100)"
	select SOC_AGM_AGRV2K
	help
	  AGM AgRV2K 303 development board. RV32IMAFC @ 200 MHz,
	  256 KB flash, 128 KB SRAM, on-die L100 FPGA fabric.
```

## boards/agm/agrv2k_303/board.yml
```yaml
board:
  name: agrv2k_303
  full_name: "AGM AgRV2K 303 (L100, 256 KB flash)"
  vendor: agm
  socs:
    - name: agrv2k
      variants:
        - name: agrv2k
```

## boards/agm/agrv2k_407/Kconfig.agrv2k_407
```kconfig
# AGM AgRV2K 407 board selection.
#
# Copyright (c) 2026 AgRV Contributors
# SPDX-License-Identifier: Apache-2.0

config BOARD_AGM_AGRV2K_407
	bool "AGM AgRV2K 407 (L100)"
	select SOC_AGM_AGRV2K
	help
	  AGM AgRV2K 407 development board. RV32IMAFC @ 240 MHz,
	  1 MB flash, 128 KB SRAM, on-die L100 FPGA fabric.
```

## boards/agm/agrv2k_407/board.yml
```yaml
board:
  name: agrv2k_407
  full_name: "AGM AgRV2K 407 (L100, 1 MB flash)"
  vendor: agm
  socs:
    - name: agrv2k
      variants:
        - name: agrv2k
```

## boards/agm/agrv2k_test/Kconfig.agrv2k_test
```kconfig
# AGM AgRV2K Test board selection.
#
# Copyright (c) 2026 AgRV Contributors
# SPDX-License-Identifier: Apache-2.0

config BOARD_AGM_AGRV2K_TEST
	bool "AGM AgRV2K Test (L100)"
	select SOC_AGM_AGRV2K
	help
	  AGM AgRV2K Test fixture board. RV32IMAFC @ 100 MHz,
	  256 KB flash, 128 KB SRAM, on-die L100 FPGA fabric.
	  Pin-compatible with agrv2k_103 but kept as a separate board
	  for SDK parity (vendor may diverge in the future).
```

## boards/agm/agrv2k_test/board.yml
```yaml
board:
  name: agrv2k_test
  full_name: "AGM AgRV2K Test (L100, 256 KB flash, SDK test fixture)"
  vendor: agm
  socs:
    - name: agrv2k
      variants:
        - name: agrv2k
```

## drivers/can/Kconfig.agm
```kconfig
# AgRV2K CAN controller configuration options
#
# Copyright (c) 2026 AgRV Contributors
# SPDX-License-Identifier: Apache-2.0

config CAN_AGRV2K
	bool "AgRV2K CAN (SJA1000-compatible PeliCAN) driver"
	default y
	depends on DT_HAS_AGM_AGRV2K_CAN_ENABLED
	select CAN_SJA1000
	select PINCTRL
	help
	  Enable support for the on-die CAN controller on AgRV2K SoCs.
	  The IP is register-compatible with the NXP SJA1000 in
	  PeliCAN mode; this driver is a thin frontend that plugs into
	  the shared can_sja1000.c state machine.

	  End-to-end verification goes through the controller's
	  MOD_SELFTEST (self-test) mode, exposed as CAN_MODE_LOOPBACK
	  through the upstream Zephyr CAN API — but it still needs a bus
	  the controller reads as idle: with nothing attached to the CAN
	  pins the transmitter never starts (SR.TS stuck, no error
	  counters). Keep the transceiver/peer on the
	  pins, as on the dev board. See samples/can_loopback/.
```

## drivers/counter/Kconfig.agm
```kconfig
# AGM AgRV2K timer configuration options
#
# Copyright (c) 2026 AgRV Contributors
# SPDX-License-Identifier: Apache-2.0

config COUNTER_AGM_TIMER
	bool "AGM AgRV2K dual timer (TIMER0/1) counter driver"
	default y
	depends on DT_HAS_AGM_AGRV2K_TIMER_ENABLED
	help
	  Enable counter driver for the AGM AgRV2K SP804-style dual
	  32-bit timer units (TIMER0/1, two sub-timers each, exposed as
	  two alarm channels).

config COUNTER_AGM_GPTIMER
	bool "AGM AgRV2K general-purpose timer (GPTIMER0-4) counter driver"
	default y
	depends on DT_HAS_AGM_AGRV2K_GPTIMER_ENABLED
	help
	  Enable counter driver for the AGM AgRV2K STM32-style general
	  purpose timers (GPTIMER0-4, one compare-channel alarm each).


config COUNTER_AGM_RTC
	bool "AGM AgRV2K RTC counter driver"
	default y
	depends on DT_HAS_AGM_AGRV2K_RTC_ENABLED
	help
	  Enable counter driver for the AGM AgRV2K backup-domain RTC
	  (0x40000000, STM32F1-style). Free-running 32-bit counter at
	  ~1 Hz (prescaler-based) with one alarm channel and an
	  overflow/top callback. The RTC keeps running in stop/standby
	  mode and is the wake source for deep low-power states .
```

## drivers/crc/Kconfig.agm
```kconfig
# AGM AgRV2K CRC driver
#
# Copyright (c) 2026 AgRV Contributors
# SPDX-License-Identifier: Apache-2.0

config CRC_AGM
	bool "AGM AgRV2K CRC driver"
	default y
	depends on DT_HAS_AGM_AGRV2K_CRC_ENABLED
	select CRC_DRIVER_HAS_CRC32_IEEE
	help
	  CRC calculation unit in the AgRV2K SYS block,
	  STM32-CRC compatible: DR/IDR/CR/INIT/POL, programmable polynomial size
	  (7/8/16/32) and seed, byte/half-word/word input reversal, bit-level
	  output reversal, 4 AHB clocks per 32-bit feed.

	  This driver claims CRC-32/ISO-HDLC (Zephyr's CRC32_IEEE) only, verified
	  on hardware against the standard check value 0xCBF43926 and against the
	  software implementation over 64 B and 99944 B buffers. Other algorithms
	  return -ENOTSUP until they are measured.

	  Enabling it also flips Zephyr's own crc32_ieee() to hardware: with a
	  zephyr,crc chosen node present, CRC_HW_HANDLER selects CRC_DRIVER and
	  subsys/crc/crc_hardware.c replaces the weak software implementation --
	  no caller changes. On the loader's boot path the 99944 B fabric CRC
	  drops from 13.39 M cycles (67 ms) to 0.70 M (3.5 ms).

	  The unit is initialised at PRE_KERNEL_1 (priority below zero) because the
	  fabric verifier runs from
	  soc.c's PRE_KERNEL_1 hook, before normal device init; soc.c opens the
	  unit's AHB clock gate before that check (see agm,ahb-clkenable-bit).
```

## drivers/dma/Kconfig.agm
```kconfig
# Copyright (c) 2026 AgRV Contributors
# SPDX-License-Identifier: Apache-2.0

config DMA_AGM
	bool "AGM AgRV2K DMA driver"
	default y
	depends on DT_HAS_AGM_AGRV2K_DMA_ENABLED
	help
	  Enable the PL080/LPC23xx-GPDMA-style DMA controller driver
	  for the AGM AgRV2K SoC.
```

## drivers/flash/Kconfig.agm
```kconfig
# AGM AgRV2K on-die flash driver
#
# Copyright (c) 2026 AgRV Contributors
# SPDX-License-Identifier: Apache-2.0

config FLASH_AGM
	bool "AGM AgRV2K on-die flash driver"
	default y
	depends on DT_HAS_AGM_AGRV2K_FLASH_CONTROLLER_ENABLED
	select FLASH_HAS_DRIVER_ENABLED
	select FLASH_HAS_PAGE_LAYOUT
	select FLASH_HAS_EXPLICIT_ERASE
	help
	  Program/erase for the AgRV2K on-die flash (1 MB on agrv2k_407) through
	  the controller at 0x4000_1000. Reading needs no driver -- the array is
	  XIP-mapped -- but erasing and programming do.

	  Sequences follow the vendor SDK (framework-agrv_sdk/src/flash.c):
	  unlock with FLASH_KEY1/2, erase one 4 KiB sector at a time via the
	  address register, program one 32-bit word at a time through the XIP
	  window with CR.PG set. CR.STRT has to be set after the flash has been
	  idle for SCLK_DIV_HIGH * 256 cycles, otherwise the start bit is
	  dropped -- the SDK's FLASH_Start() delay, reproduced here.

	  Note what this driver does *not* touch: the last 100 KiB of the flash
	  holds the fabric bitstream (AGM_BITSTREAM_ADDR = 0x800e7000) and the
	  running image occupies the front of the array. Callers own that
	  layout.
```

## drivers/i2c/Kconfig.agm
```kconfig
# Copyright (c) 2026 AgRV Contributors
# SPDX-License-Identifier: Apache-2.0

config I2C_AGM
	bool "AGM AgRV2K I2C driver"
	default y
	depends on DT_HAS_AGM_AGRV2K_I2C_ENABLED
	select PINCTRL
	help
	  Enable the OpenCores-style I2C master controller driver for
	  the AGM AgRV2K SoC.
```
