## dts/bindings/misc/agm,agrv2k-cpld.yaml
```yaml
# Copyright (c) 2026 AgRV Contributors
# SPDX-License-Identifier: Apache-2.0

description: |
  AgRV2K CPLD (FPGA fabric) AHB slave window.

  The SoC address decoder routes any MCU load/store in
  0x60000000-0x7FFFFFFF to the fabric's `mem_ahb_*` slave port (vendor
  documents it in its MCU+CPLD programming note; the port shows up in the
  generated netlist, <build>/logic/board.vx). Writes land at fabric
  offset haddr[23:0] of the window, reads come back on the same bus, and a
  fabric that does not answer the handshake stalls the CPU -- so the
  node only makes sense on a board whose bitstream implements a slave.

  The register map *inside* the window is defined by the user's Verilog
  (`analog_ip.v` in the vendor examples), not by the SoC, which is why
  this binding describes nothing but the window itself. The node carries
  the AGM driver (drivers/misc/cpld_agm.c, CONFIG_CPLD_AGM) and is accessed
  through include/zephyr/drivers/misc/cpld_agm.h
  (agm_cpld_read32 / write32 / update_bits / get_base / get_size), which
  range-checks every offset against `reg` before touching the bus.

  Do NOT add "syscon" to the compatible list as well: the generic syscon
  driver would then instantiate a second device for this node, and both
  definitions carry the node's ordinal name (`__device_dts_ord_<n>`), so
  the link fails with "multiple definition". The
  syscon driver stays available for other nodes (sys@0x3000000 keeps it).

  Bitstream-specific behaviour (named registers, CPLD-to-GPIO interrupts,
  DMA handshake) extends the driver, not this binding, until the semantics
  are stable enough to describe in devicetree -- see


compatible: "agm,agrv2k-cpld"

include: [base.yaml]

properties:
  reg:
    required: true
    description: |
      The fabric window as seen by the MCU. Must cover the highest offset
      the bitstream decodes: the vendor examples put ADC0/1/2 at +0x0 /
      +0x1000 / +0x2000 and SPI0 at +0x6000, so a board that uses them
      needs at least 0x8000. The driver rejects any access outside it.
```

## dts/bindings/pwm/agm,agrv2k-gptimer-pwm.yaml
```yaml
# Copyright (c) 2026 AgRV Contributors
# SPDX-License-Identifier: Apache-2.0

description: |
  PWM output channels on the AGM AgRV2K general-purpose timers
  (GPTIMER0-4). Reuses the same hardware IP as the counter driver
  (`agm,agrv2k-gptimer`); the two drivers are mutually exclusive
  on a given instance (the PWM driver claims the timer at init).

  The hardware is STM32-style: a free-running 32-bit up-counter
  with auto-reload (ARR), prescaler (PSC) and four capture/compare
  channels. Each PWM channel maps to one CCx output and one CCRx
  register. Output polarity is via CCER.CCxP; complementary outputs
  and dead-time (BDTR.MOE/DTG) are not yet exposed (v1 single-ended
  only).

  Physical pin output requires:
    1. The SoC-level AFSEL bit (in GPIOx + 0x420) is set for the
       pin group (this is the same bit set in soc.c for UART and
       I2C; the PWM driver does NOT touch AFSEL itself).
    2. The FPGA bitstream (board.ve) routes the timer's CCx output
       to a real pin on the L100 fabric.

  Without (2) the registers are programmed correctly and CCxIF
  fires on time, but the pin never toggles — the bitstream
  decision is board-level and tracked separately
  follow-ups.

compatible: "agm,agrv2k-gptimer-pwm"

include: [pwm-controller.yaml, base.yaml, pinctrl-device.yaml]

properties:
  reg:
    required: true

  clocks:
    required: true
    description: |
      SYSCLK feed for this block. PBUS_DIVIDER resets to 0, so pclk == SYSCLK:
      reference the board's clk0 fixed-clock instead of copying the number --
      the driver reads it with DT_INST_PROP_BY_PHANDLE(n, clocks,
      clock_frequency), exactly like the UART and CAN drivers. A board that
      changes SYSCLK only edits &clk0.
  agm,apb-clkenable-bit:
    type: int
    required: true
    description: |
      Bit index in SYS.APB_CLKENABLE (0x03000000 + 0x60) gating this
      instance's APB clock (16..20 for GPTIMER0..4, SDK APB_MASK_GPTIMERx).
      SoC bring-up opens it from here, so a board that uses a timer only as
      a PWM source does not need the counter node enabled to get a clock.
  prescaler:
    type: int
    default: 0
    min: 0
    max: 65535
    description: |
      Value for the counter prescaler register PSC (0x28). The counter
      advances one tick every (prescaler + 1) pclk cycles, so the tick
      rate is `pclk / (prescaler + 1)`. pwm_get_cycles_per_sec() reports
      that divided value, and pwm_set_cycles() period/pulse arguments
      are in those ticks, so an application reads back the rate it has
      to compute them against and does not need to know the prescaler.

      0 (the default) means divide by one, i.e. the counter ticks at
      pclk, which is what every shipped node uses. Prescaling lowers
      the tick rate but also shortens the longest period ARR (32 bits)
      can express by the same factor; at the 200 MHz of the shipped
      407 bitstream ARR alone already spans ~21.5 s.

      16 bits, not 32: see the counter binding for the full argument.
      The implemented field is PSC[15:0], the high half neither reads
      back nor divides, and the SDK's GPTIMER_InitTypeDef.Prescaler is
      uint16_t, so max is 65535.

  "#pwm-cells":
    const: 3

pwm-cells:
  - channel
  - period
  - flags
```

## dts/bindings/serial/agm,agrv2k-uart.yaml
```yaml
# Copyright (c) 2026 AgRV Contributors
# SPDX-License-Identifier: Apache-2.0

title: AgRV2K UART

description: |
  On-die UART (uart0 @ 0x40025000) on AGM AgRV2K SoCs, served by the
  native driver in this module (drivers/serial/uart_agm.c).

  The IP is register-compatible with ARM PL011 (DR / RSR / FR / IBRD /
  FBRD / LCR_H / CR / IMSC / RIS / MIS / ICR), so this binding inherits
  the upstream property surface from arm,pl011.yaml and adds nothing
  of its own. The vendor compatible exists for one reason:
  DT_HAS_<COMPAT>_ENABLED is derived from the devicetree, so dropping
  "arm,pl011" from the node makes CONFIG_UART_PL011 (which depends on
  DT_HAS_ARM_PL011_ENABLED || DT_HAS_ARM_SBSA_UART_ENABLED, and is
  "default y") unconfigurable on AGM boards. Keeping "arm,pl011" as
  an additional compatible would leave that option selectable and let
  two drivers instantiate the same node — a duplicate-device failure
  that Kconfig can no longer stop.

  Pin routing is separate from the electrical attributes: pinctrl-0
  carries the alternate-function route (bank/bit of the TX and RX pins,
  AGM_PINCTRL() cells), which pinctrl_configure_pins() turns into AFSEL +
  DIR writes. Pull/drive settings are NOT runtime registers on this SoC —
  the bitstream's ASF owns them, so this binding accepts no
  bias-pull-*/drive-strength at all.

compatible: "agm,agrv2k-uart"

include: ["arm,pl011.yaml"]

properties:
  reg:
    required: true

  interrupts:
    required: true

  clocks:
    required: true

  agm,apb-clkenable-bit:
    type: int
    required: true
    description: |
      Bit index in SYS.APB_CLKENABLE (0x03000000 + 0x60) that gates this
      UART's APB clock. The block is closed at reset, so SoC bring-up
      opens it before the first register access (see soc/agm/agrv2k/soc.c
      and the same convention in the CAN/I2C/GPTIMER drivers).
```

## dts/bindings/spi/agm,agrv2k-spi.yaml
```yaml
# Copyright (c) 2026 AgRV Contributors
# SPDX-License-Identifier: Apache-2.0

description: |
  AgRV2K SPI controller (0x40012000 SPI0 / 0x40013000 SPI1).

  The IP is a phase engine, not a byte-at-a-time SPI shifter: a transfer
  is programmed as up to 8 phases (TX / DUMMY_TX / RX / POLL, each single
  / dual / quad, each with its own byte count) that run back to back
  inside one chip-select window. That is what makes it a good SPI-flash
  controller and a poor general-purpose one -- the vendor's own summary
  lists the constraints:

    1. the first phase must be TX (a transfer cannot start with RX);
    2. RX and TX are never simultaneous (TX phases, then RX phases);
    3. RX must be the last phase (nothing clocks after it).

  A device that fits those rules works with this controller alone. A
  device that does not (full-duplex sensors, RX-first protocols, CPOL or
  CPHA other than mode 0) needs the FPGA fabric: the vendor patch
  `full_duplex_spi.v` sits between the SPI signals and the pins and adds
  a full-duplex RX path plus CPOL/CPHA, controlled through the CPLD
  window.

compatible: "agm,agrv2k-spi"

include: [spi-controller.yaml, pinctrl-device.yaml]

properties:
  reg:
    required: true

  interrupts:
    required: true

  clocks:
    required: true
    description: |
      SCLK parent (clk0 = SYSCLK). The engine divides it by 2..256
      (SCLK_DIV field, 0 meaning 256), so a request is satisfied by
      picking the smallest divider that does not exceed the requested
      frequency.

  agm,apb-clkenable-bit:
    type: int
    required: true
    description: |
      SYS.APB_CLKENABLE bit for this controller (SPI0 = 2, SPI1 = 3).
      soc.c opens it at PRE_KERNEL_1.

  dmas:
    description: |
      TX and RX DMA channel specifiers, in that order (`dma-names = "tx",
      "rx"`). The engine streams a transfer longer than four bytes through
      the phase data register with DMA; the channel is arbitrary but the
      two must differ.

  dma-names:
    description: |
      Must be "tx", "rx" (matches the dmas order).

  agm,tx-dma-request:
    type: int
    description: |
      Peripheral handshake line for the TX direction (SPI0 = 6, SPI1 = 8;
      SDK AltaRiscv.h SPIx_TX_DMA_REQ). Needed only when `dmas` is present.

  agm,rx-dma-request:
    type: int
    description: |
      Peripheral handshake line for the RX direction (SPI0 = 7, SPI1 = 9;
      SDK AltaRiscv.h SPIx_RX_DMA_REQ). Needed only when `dmas` is present.

  agm,spi-multiline:
    type: int
    required: false
    default: 0
    description: |
      Bitstream-declared multi-line fabric capability:
        0 = single only (default; matches vendor <build_dir>/zephyr/board.bin)
        1 = dual SPI capable
        2 = quad SPI capable
      Driver rejects SPI_LINES_DUAL/QUAD with -ENOTSUP if the requested
      line mode exceeds this value. The quad-capable bitstream
      ~/spi_full_bitstream_97pad/ declares 2 here.
```

## dts/bindings/usb/agm,agrv2k-uhc.yaml
```yaml
# Copyright (c) 2026 AgRV Contributors
# SPDX-License-Identifier: Apache-2.0

description: |
  AgRV2K USB0 host controller. Same silicon block as agm,agrv2k-usb0 (the
  FSL/ChipIdea-like dual-role controller), but driven in host mode through
  the EHCI-compatible operational registers (USBCMD/USBSTS/PORTSC, the
  asynchronous queue-head list and the periodic frame list).

  Kept as a *separate* node from the device-mode agm,agrv2k-usb0 even though
  both live at 0x4100_1000: one devicetree node may only back one driver
  (DEVICE_DT_INST_DEFINE names devices by node ordinal, so two drivers on one
  node collide at link time), and the role is chosen by which node an
  application enables. A build must enable exactly one of the two.

compatible: "agm,agrv2k-uhc"

include: [usb-controller.yaml]

properties:
  reg:
    required: true

  interrupts:
    required: true

  agm,ahb-clkenable-bit:
    type: int
    required: true
    description: |
      Bit index in SYS.AHB_CLKENABLE (0x03000000 + 0x70) gating USB0's AHB
      clock. USB0 is bit 1; the neighbouring bits belong to other peripherals
      (DMAC0 = 0, CRC0 = 2, MAC0 = 3), so a value other than 1 would gate the
      wrong block.
    enum: [1]

  agm,ahb-reset-bit:
    type: int
    required: true
    description: |
      Bit index in SYS.AHB_RESET (0x03000000 + 0x50) holding USB0 in reset;
      write 1 = assert, so bring-up clears it (bit 1, same index as the gate).
    enum: [1]
```

## dts/bindings/usb/agm,agrv2k-usb0.yaml
```yaml
# Copyright (c) 2026 AgRV Contributors
# SPDX-License-Identifier: Apache-2.0

description: AgRV2K USB0 device controller (FSL/ChipIdea-like, FS only, device mode).

compatible: "agm,agrv2k-usb0"

include: usb-ep.yaml

bus: usb

properties:
  reg:
    required: true

  interrupts:
    required: true

  agm,ahb-clkenable-bit:
    type: int
    required: true
    description: |
      Bit index in SYS.AHB_CLKENABLE (0x03000000 + 0x70) gating USB0's AHB
      clock. USB0 is bit 1; the neighbouring bits belong to other peripherals
      (DMAC0 = 0, CRC0 = 2, MAC0 = 3), so a value other than 1 would gate the
      wrong block.
    enum: [1]

  agm,ahb-reset-bit:
    type: int
    required: true
    description: |
      Bit index in SYS.AHB_RESET (0x03000000 + 0x50) holding USB0 in reset;
      write 1 = assert, so bring-up clears it (bit 1, same index as the gate).
    enum: [1]
```
