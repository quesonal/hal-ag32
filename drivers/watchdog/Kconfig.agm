## dts/bindings/ethernet/agm,agrv2k-emac.yaml
```yaml
# Copyright (c) 2026 AgRV Contributors
# SPDX-License-Identifier: Apache-2.0

description: |
  AgRV2K on-die Ethernet MAC (MAC0 at 0x41040000).

  The MAC block exposes TX/RX descriptor rings, a hardware MDIO
  controller, and an RMII/MII PHY interface. AgRV2K has exactly one
  MAC instance; this binding covers it. The MDIO controller is a
  child node (see agm,agrv2k-mdio.yaml); it shares the parent MAC's
  AHB gate and the AFSEL on the two pins.

  The driver lives at drivers/ethernet/eth_agm.c and plugs into the
  Zephyr Ethernet framework via NET_DEVICE_DT_INST_DEFINE().

compatible: "agm,agrv2k-emac"

include: [ethernet-controller.yaml, pinctrl-device.yaml]

properties:
  reg:
    required: true
  interrupts:
    required: true
  agm,ahb-clkenable-bit:
    required: true
    type: int
    description: |
      Bit in SYS.AHB_CLKENABLE that opens the MAC0 gate (3 on
      AgRV2K). soc/agm/agrv2k/soc.c opens the gate before any
      device driver runs.
  agm,ahb-reset-bit:
    required: true
    type: int
    description: |
      Bit index in SYS.AHB_RESET (0x03000000 + 0x50) holding MAC0 in
      reset; write 1 = assert, so bring-up clears it. Same index as
      agm,ahb-clkenable-bit on AgRV2K (the two registers share a
      layout for the supported peripherals) -- bit 3, with DMAC0 = 0,
      USB0 = 1 and CRC0 = 2 as its neighbours.
  phy-connection-type:
    default: "rmii"
```

## dts/bindings/ethernet/mdio/agm,agrv2k-mdio.yaml
```yaml
# Copyright (c) 2026 AgRV Contributors
# SPDX-License-Identifier: Apache-2.0

description: |
  AgRV2K MAC0 hardware MDIO controller.

  The MDIO register is part of the MAC0 register file (offset 0x10
  from 0x41040000); the controller has its own AFSEL on the MDC/MDIO
  pins but no separate clock/reset domain. Drivers should be children
  of an `agm,agrv2k-emac` parent node and inherit its reg/interrupt
  semantics -- this binding does not require its own reg.

  Driver: drivers/ethernet/mdio/mdio_agm.c.

compatible: "agm,agrv2k-mdio"

include: [mdio-controller.yaml, pinctrl-device.yaml]
```

## dts/bindings/ethernet/microchip,lan8720.yaml
```yaml
# Copyright (c) 2026 AgRV Contributors
# SPDX-License-Identifier: Apache-2.0

description: |
  Microchip (formerly SMSC) LAN8720 10/100 Ethernet PHY with RMII interface.

  Same register layout as microchip,lan8742 (the OUI is identical:
  ID1=0x0007, ID2=0xC0Fx for LAN8720, 0xC13x for LAN8742, both Microchip
  after SMSC's acquisition). The driver in this module is a slim
  rewrite of the upstream pattern so the LAN8720 PHY ID is matched
  explicitly (the LAN8742 driver accepts ID2=0xC0Fx as well, but
  rejects the revision-mismatch path on init; cleaner to own the
  compatible).

  This binding only covers the PHY probe / status path. A fabric-soft
  MAC IP is needed for the TX/RX side and lives outside the scope of
  the upstream PHY framework.

compatible: "microchip,lan8720"

include: [ethernet-phy-common.yaml]

on-bus: mdio

properties:
  reg:
    required: true
    description: |
      5-bit MDIO PHY address for the attached PHY. The LAN8720
      PHYAD[1:0] straps (RXER/PHYAD0, CRS_DV/PHYAD1) are read on
      reset; PHYAD0/PHYAD1 floating default to address 0. Pick
      whatever the on-board strapping puts on the bus.

  reset-gpios:
    type: phandle-array
    description: |
      GPIO connected to nRST pin (active-low, open-drain on the chip).
      The driver pulses it for >= 1 ms then waits 25 ms before the
      soft reset.

  default-speeds:
    default: ["10BASE Half-Duplex", "10BASE Full-Duplex", "100BASE Half-Duplex",
              "100BASE Full-Duplex"]
    description: |
      LAN8720 is 10/100 only; 1000BASE entries are ignored.

  energy-detect-mode:
    type: boolean
    description: |
      When present, the driver sets MODE[2:0] = 011b after autoneg
      completes, putting the PHY into the energy-detect power-down
      mode when the link is down. Default off (MODE=000b, all
      capable, autoneg enabled). Maps to LAN8720 reg 17 / 0x11
      bits[5:3] in some datasheet revisions.
```

## dts/bindings/flash_controller/agm,agrv2k-flash-controller.yaml
```yaml
# Copyright (c) 2026 AgRV Contributors
# SPDX-License-Identifier: Apache-2.0

description: |
  AgRV2K on-die flash controller.

  The flash array itself is XIP-mapped at 0x8000_0000 (child `soc-nv-flash`
  node); this controller adds program/erase, the option-byte window
  (0x8100_0000) and the status/error bits at 0x4000_1000. The register
  layout matches the vendor SDK's
  `FLASH_TypeDef` in framework-agrv_sdk/src/flash.h, whose sequences this
  driver follows: unlock with the two keys written to KEYR, erase with
  AR + CR.SER + CR.STRT, program by setting CR.PG and writing the word
  through the XIP window.

  Erase granularity is 4 KiB (the SDK's FLASH_SECTOR_SIZE and the value the
  AgRV openocd flow's `flash erase_address pin` assumes); programming is
  32-bit (SDK FLASH_ProgramWord).

compatible: "agm,agrv2k-flash-controller"

include: flash-controller.yaml
```

## dts/bindings/i2c/agm,agrv2k-i2c.yaml
```yaml
# Copyright (c) 2026 AgRV Contributors
# SPDX-License-Identifier: Apache-2.0

description: |
  AGM AgRV2K I2C controller. Register map is the OpenCores I2C
  master core (PRERLO/PRERHI/CTR/TXR/RXR/CR/SR).

  The SCL/SDA pins are open-drain and their direction belongs to the I2C IP,
  so the pinctrl state that routes them (pinctrl-0) uses AGM_PINCTRL_NO_DIR
  cells: AFSEL is set, DIR is left alone. See
  dts/bindings/pinctrl/agm,agrv2k-pinctrl.yaml.

compatible: "agm,agrv2k-i2c"

include: [i2c-controller.yaml, pinctrl-device.yaml]

properties:
  reg:
    required: true

  clock-frequency:
    default: 100000

  agm,apb-clkenable-bit:
    type: int
    required: true
    description: |
      Bit index in SYS.APB_CLKENABLE (0x03000000 + 0x60) that gates this I2C
      instance's APB clock: 27 for I2C0, 28 for I2C1 (SDK APB_MASK_I2C0/1).
      SoC bring-up opens it, along with the bank gate of the SCL/SDA pins
      named by pinctrl-0.

  clocks:
    required: true
    description: |
      SYSCLK feed for this block. PBUS_DIVIDER resets to 0, so pclk == SYSCLK:
      reference the board's clk0 fixed-clock instead of copying the number --
      the driver reads it with DT_INST_PROP_BY_PHANDLE(n, clocks,
      clock_frequency), exactly like the UART and CAN drivers. A board that
      changes SYSCLK only edits &clk0.
```

## dts/bindings/misc/agm,agrv2k-boot.yaml
```yaml
# Copyright (c) 2026 AgRV Contributors
# SPDX-License-Identifier: Apache-2.0

description: |
  AgRV2K bootloader / DFU storage layout.

  The AgRV2K has one on-die 1 MiB flash (0x80000000) and, on the eval
  boards, one SPI NOR behind the fabric. A bootloader in the low part of
  the on-die flash uses the NOR as an image store: a boot record in its
  first sector, an A/B pair of image stores above it, and a staging area
  for the fabric bitstream. This binding describes that layout, so the
  driver (drivers/misc/boot_agm.c, CONFIG_BOOT_AGM) can be pointed at
  another board by changing the node instead of the code.

  The regions:

  * `record-offset`/`record-size`: the boot record sector (magic, mode,
    per-slot length/CRC/state/attempts, which slot is active) inside
    `store-flash`.
  * `store-a-offset`/`store-b-offset`: the two image stores inside
    `store-flash`, `store-max-size` bytes each (the default layout keeps one
    sector free in front of them, hence the name).
  * `slot-address`/`slot-size`: the application slot inside the on-die
    flash; a store is copied there before it is executed (or the image is
    programmed there directly, "on-die DFU", in which case nothing is
    copied).
  * `bitstream-address`/`bitstream-size`: the *factory* fabric slot -- what
    the flash option byte points at. The driver never writes it; a bitstream
    update goes into the slot that is not running and a boot record (whose
    addresses are the SoC's, see
    include/zephyr/drivers/misc/agm_bitstream.h) commits it for the next boot.

  Offsets are relative to the flash device they belong to; addresses
  (`slot-address`, `bitstream-address`) are absolute, so a board whose
  internal flash is not mapped at 0x80000000 still works.

  There are two families, told apart by whether the images live in the same
  flash as the execution slot:

  * **on-die A/B** (`store-flash` and `on-die-flash` are the same node, the
    default): the node gives the *sizes* -- `loader-size` and `app-size` --
    and the driver derives the rest, so one number moves the whole layout:

      loader-size | record (2 sectors) | side A | side B | slot | staging

    with `bitstream-address` (fixed by the SoC) as the ceiling. The build
    asserts the result fits, so the offsets do not appear in the node at all
    (declaring them there is an error).
  * **two flashes** (`store-flash` is the on-board SPI NOR): the record, the
    two sides and the bitstream staging live in the NOR, the slot and the
    fabric reservation in the on-die flash. The two flashes have independent
    address spaces, so this family spells every offset out.

  Do not add another compatible to the node: one devicetree node can only
  back one driver (the ordinal-named `__device_dts_ord_<n>` symbol would
  be defined twice).

  A second, not-yet-implemented layout family ("exec-in-place"): instead
  of "two stores + one execution slot" the two slots are each the region
  the image runs from (`slot-a-address` / `slot-b-address`), which drops
  the copy step and lifts each slot from 60 KiB to about 416 KiB.
  Only useful if the loader region cannot fit the image (≈ 200 KiB
  on-die flash, ≥ 200 KiB off die);today's default layout fits,so this
  is left as a comment in the binding.

compatible: "agm,agrv2k-boot"

include: [base.yaml]

properties:
  store-flash:
    type: phandle
    required: true
    description: |
      Flash device that holds the boot record, the A/B image stores and the
      bitstream staging area. On the eval boards this is the SPI NOR behind
      the fabric (the default layout); pointing it at the on-die flash as
      well turns the bootloader into an on-die-only A/B scheme (record,
      stores, execution slot and staging all inside the 1 MiB internal
      flash), with the region offsets below simply being on-die offsets.

  on-die-flash:
    type: phandle
    required: true
    description: |
      Device of the on-die flash that holds the application slot and the
      bitstream reservation.

  on-die-flash-base:
    type: int
    description: |
      Address the on-die flash is mapped at, i.e. the value subtracted from
      `slot-address` / `bitstream-address` to get device offsets. Normally
      taken from the flash node's `reg`; set this when that node does not
      carry one (a simulated flash, for instance), which also turns off the
      build-time check that the reservation fits inside the flash.

  record-offset:
    type: int
    description: |
      Offset of the boot record in the flash that holds it. The record spans
      two `record-size` sectors from there (it is an append log with a spare
      generation), so
      `store-a-offset` has to start at or after `record-offset +
      2 * record-size` -- the driver asserts that at build time.

      Two-flash family only: in the on-die family the record follows the
      loader's region (`loader-size`).

  loader-size:
    type: int
    default: 0x18000
    description: |
      On-die family only: how much of the flash below the boot record belongs
      to the bootloader. The default is 96 KiB, which is what a signed loader
      needs ~72768 B, plus the trial-boot watchdog the
      loader arms (604 B of driver) -- and the *loader* is linked against a
      partition of exactly this size, so a loader that grows past it fails the
      build instead of running into the record
      3.26.27).

  app-size:
    type: int
    default: 0x32000
    description: |
      On-die family only: the largest image each A/B side accepts, which is
      also the size of the application slot. One number for "how big can my
      application be"; the default is 200 KiB.

      The whole layout follows from it and `loader-size`:

        loader-size | record | side A | side B | slot | bitstream staging

      and the build asserts that the staging still ends below
      `bitstream-address` (the SoC's fabric reservation).

  record-size:
    type: int
    default: 4096
    description: |
      Size of one boot record sector; also the erase granularity the driver
      uses (both flashes on this SoC erase 4 KiB at a time). The record itself
      occupies two of these sectors.

  store-a-offset:
    type: int
    description: |
      Offset of image store A in the record's flash. Must clear the record
      (`record-offset + 2 * record-size`).

      Two-flash family only (see `app-size` for the on-die family).

  store-b-offset:
    type: int
    description: Offset of image store B in the external flash.

      Two-flash family only.

  store-max-size:
    type: int
    description: |
      Largest image a store may hold. Must not overlap the store that
      follows it in the external flash.

      Two-flash family only; the on-die family uses `app-size`.

  slot-address:
    type: int
    description: Absolute address of the application slot (where images run).

      Two-flash family only; the on-die family derives it from `loader-size`,
      `app-size` and the record.

  slot-size:
    type: int
    description: Size of the application slot.

      Two-flash family only; the on-die family uses `app-size`.

  bitstream-address:
    type: int
    required: true
    description: Absolute address of the on-die bitstream reservation.

  bitstream-size:
    type: int
    required: true
    description: |
      Size of the on-die bitstream reservation -- the factory slot, which the
      flash option byte points at and which this driver never writes.

      Updates go into the two slots the SoC header defines instead
      (include/zephyr/drivers/misc/agm_bitstream.h): the upload writes the
      slot that is not running and a boot record commits it, so nothing ever
      rewrites the region the running fabric came from. There is no staging
      area and no `BSB1` header any more -- the host's bytes land in the slot
      exactly as sent.
```
