## drivers/watchdog/Kconfig.agm
```kconfig
# AGM AgRV2K watchdog configuration options
#
# Copyright (c) 2026 AgRV Contributors
# SPDX-License-Identifier: Apache-2.0

config WDT_AGRV2K
	bool "AGM AgRV2K system watchdog (WDOG0) driver"
	default y
	depends on DT_HAS_AGM_AGRV2K_WDT_ENABLED
	help
	  Enable the SP805-style system watchdog (WDOG0 @ 0x40011000)
	  on AGM AgRV2K SoCs. The 32-bit countdown runs at pclk;
	  timeouts can reset the SoC and/or raise a PLIC interrupt
	  (single timeout channel, as in the SDK watchdog.h).

config WDT_AGRV2K_IWDG
	bool "AGM AgRV2K independent watchdog (IWDG) driver"
	default y
	depends on DT_HAS_AGM_AGRV2K_IWDG_ENABLED
	help
	  Enable the backup-domain independent watchdog (IWDG, vendor
	  SDK framework-agrv_sdk/src/iwdg.h). 16-bit register at RTC
	  base + 0x34, clocked by LSI (internal 32 kHz) or LSE
	  (32768 Hz crystal) through 8 prescaler taps. No PLIC IRQ
	  (reset-only); feeds write the key 0xa000.
```

## dts/bindings/can/agm,agrv2k-can.yaml
```yaml
# Copyright (c) 2026 AgRV Contributors
# SPDX-License-Identifier: Apache-2.0

title: AgRV2K CAN (SJA1000-compatible PeliCAN) controller

description: |
  On-die CAN controller on AGM AgRV2K SoCs. The IP is register-
  compatible with the NXP SJA1000 in PeliCAN mode (classic CAN 2.0A
  and 2.0B; 11-bit and 29-bit identifiers). The 8-bit SJA1000
  register file is mapped on a 32-bit word stride.

  Supports the MOD_SELFTEST (loopback) and MOD_LISTONLY mode bits.

  The controller is clocked directly from SYSCLK (the bitstream feeds
  it as the SJA1000 "XTAL1" input), so `clocks` must point at the node
  carrying the board SYSCLK frequency -- on AgRV2K that is the clk0
  fixed-clock the boards already override per variant. The driver
  derives the SJA1000 core clock (f_can / 2) and the minimum supported
  bit rate from it.

  CAN TX/RX pins (CAN0_TX0 on PIN_39 / CAN0_RX0 on PIN_38 on the
  shipped agrv2k_407 bitstream) are routed by the FPGA bitstream down to
  the GPIO bank, but the final step is runtime: pinctrl-0 names a state
  whose AGM_PINCTRL() cells carry the bank/bit of both pins, and the
  driver applies it (pinctrl_configure_pins() writes AFSEL + DIR). See
  the pin controller binding for the cell format.

compatible: "agm,agrv2k-can"

include: [can-controller.yaml, pinctrl-device.yaml]

properties:
  reg:
    required: true

  clocks:
    required: true

  interrupts:
    required: true

  agm,apb-clkenable-bit:
    type: int
    required: true
    description: |
      Bit index in SYS.APB_CLKENABLE (0x03000000 + 0x60) that gates the
      CAN0 APB clock. 26 on AgRV2K (SDK APB_MASK_CAN0).
```

## dts/bindings/clock/agm,agrv2k-sys.yaml
```yaml
# Copyright (c) 2026 AgRV Contributors
# SPDX-License-Identifier: Apache-2.0

description: |
  AgRV2K SoC system controller (clock + reset + APB gating). Mirrors
  the AgRV SDK's SYS controller layout (registers at 0x03000000).

  In addition to the syscon register block, this node carries the
  FLASH ceiling and a reference to the SYSCLK source, both consumed by
  zephyr/soc/agm/agrv2k/soc.c at PRE_KERNEL_1:
    clocks (-> clk0)      — SYSCLK after the FCB PLL switch (Hz). Drives
                            BOARD_PLL_FREQUENCY and the SDK
                            SCLK_DIV_HIGH/LOW programming. A phandle, not a
                            copied number: boards set the rate once on the
                            fixed-clock node, and every consumer (UART, CAN,
                            timers, PWM, WDT, I2C, this controller) follows.
    flash-max-frequency   — Maximum clock rate the on-die FLASH controller
                            can tolerate (Hz). Drives FLASH_MAX_FREQ and
                            the SAFE divider the soc.c writes at boot.

  Why these live on sys and not on cpu0:
    * cpu0::clock-frequency is the CPU clock and is also used by the
      Zephyr kernel timer, which reads it as a plain integer (its Kconfig
      is derived from /cpus/cpu0), so it cannot be a phandle. The FLASH
      ceiling is the FLASH IP's electrical limit, not a per-board decision.

compatible: "agm,agrv2k-sys"

include: [syscon.yaml, clock-controller.yaml]

properties:
  reg:
    required: true

  clocks:
    required: true
    description: |
      The SYSCLK source (the board's clk0 fixed-clock). soc.c/pm.c read it
      with DT_PROP_BY_PHANDLE(DT_NODELABEL(sys), clocks, clock_frequency)
      and use it to program SYS_SCLK_DIV_HIGH/LOW before asserting PLL_RDY,
      and to re-lock the PLL after a stop-mode wake.

  flash-max-frequency:
    type: int
    description: |
      Maximum FLASH controller clock rate (Hz). Typically BUSCLK from
      the board.ve line, or the FLASH IP electrical limit if lower.
      soc.c computes SCLK_DIV = (SYSCLK − 1) / flash-max-frequency.

  "#clock-cells":
    const: 0
```

## dts/bindings/counter/agm,agrv2k-gptimer.yaml
```yaml
# Copyright (c) 2026 AgRV Contributors
# SPDX-License-Identifier: Apache-2.0

description: |
  AGM AgRV2K general-purpose timer (GPTIMER0-4). STM32-style timer
  with a free-running up-counter (CNT), auto-reload (ARR), prescaler
  (PSC) and capture/compare channels. The counter driver exposes one
  alarm channel (compare channel 0) and a top callback on the counter
  wrap; the count value is a 32-bit count-up value wrapping every
  2^32 ticks (pclk ticks).

compatible: "agm,agrv2k-gptimer"

include: base.yaml

properties:
  reg:
    required: true

  interrupts:
    required: true

  clocks:
    required: true
    description: |
      SYSCLK feed for this block. PBUS_DIVIDER resets to 0, so pclk == SYSCLK:
      reference the board's clk0 fixed-clock instead of copying the number --
      the driver reads it with DT_INST_PROP_BY_PHANDLE(n, clocks,
      clock_frequency), exactly like the UART and CAN drivers. A board that
      changes SYSCLK only edits &clk0.
  agm,apb-clkenable-bit:
    type: int
    required: true
    description: |
      Bit index in SYS.APB_CLKENABLE (0x03000000 + 0x60) gating this
      instance's APB clock: 16 for GPTIMER0 through 20 for GPTIMER4 (SDK
      APB_MASK_GPTIMERx). SoC bring-up opens it from here; the driver no
      longer derives it from the register address.
  prescaler:
    type: int
    default: 0
    min: 0
    max: 65535
    description: |
      Value for the counter prescaler register PSC (0x28). The counter
      advances one tick every (prescaler + 1) pclk cycles, so the tick
      rate is `pclk / (prescaler + 1)` and counter_get_freq() reports
      that divided value. 0 (the default) means divide by one, i.e. the
      counter ticks at pclk, which is what every shipped node uses.

      16 bits, not 32. The register sits in a 32-bit window and the SDK
      register map declares it uint32_t, which reads as 32-bit, but the
      implemented field is PSC[15:0]: the high half does not read back
      and does not divide. The SDK's own GPTIMER_InitTypeDef agrees,
      its Prescaler member being uint16_t. max is therefore 65535
      rather than 0xffffffff, so a too-wide value is a build-time
      devicetree error instead of a silently dropped high half.

      Divide down only to reach a frequency the 32-bit ARR cannot:
      the period is (ARR + 1) / (pclk / (prescaler + 1)), and ARR is
      32 bits, so prescaling also divides down the longest period the
      counter can express by the same factor. At
      the 200 MHz the shipped 407 bitstream runs, ARR alone already spans
      ~21.5 s, so leave this at 0 unless a board needs a tick rate low
      enough that 2^32 counts no longer covers the wanted period.
```

## dts/bindings/counter/agm,agrv2k-rtc.yaml
```yaml
# Copyright (c) 2026 AgRV Contributors
# SPDX-License-Identifier: Apache-2.0

description: |
  AGM AgRV2K RTC @ 0x40000000, exposed as a Zephyr counter device.
  STM32F1-style 16-bit-halfword RTC in the backup domain: 20-bit
  prescaler (PRLH/PRLL), 32-bit up counter (CNTH/CNTL, increments
  every (prescaler + 1) rtc-clock ticks) and a 32-bit alarm
  (ALRH/ALRL, single channel). PLIC IRQ 2; clock source / frequency
  are board-level properties (agm,rtc-source / agm,rtc-frequency).
  The RTC keeps running in stop/standby mode and is the wake source
  for deep low-power states. See the
  SDK framework-agrv_sdk/src/rtc.h.

compatible: "agm,agrv2k-rtc"

include: base.yaml

properties:
  reg:
    required: true

  interrupts:
    required: true

  agm,rtc-source:
    type: string
    required: false
    default: "lse"
    enum:
      - "lse"
      - "lsi"
      - "local"
    description: |
      RTC clock source written to BDCR RTCSEL (SDK
      RTC_ClkSourceTypeDef): "lse" = external 32.768 kHz crystal
      (SDK default via board_rtc_source()), "lsi" = internal RC,
      "local" = on-die oscillator. LSE requires the LSERDY flag;
      the other sources start without a ready wait.

  agm,rtc-frequency:
    type: int
    required: false
    default: 32768
    description: |
      Frequency (Hz) of the selected RTC clock source. Defaults to
      the LSE 32768 Hz; must be overridden when agm,rtc-source is
      "lsi" or "local" and the rate is not 32768.

  agm,prescaler:
    type: int
    required: false
    default: 32767
    description: |
      RTC prescaler reload value (PRL). The counter increments every
      (agm,prescaler + 1) rtc-clock ticks, so the default 32767 with
      a 32768 Hz source yields a 1 Hz counter (one tick per second).
      Lower values speed the counter up for fast alarm tests.
```

## dts/bindings/counter/agm,agrv2k-timer.yaml
```yaml
# Copyright (c) 2026 AgRV Contributors
# SPDX-License-Identifier: Apache-2.0

description: |
  AGM AgRV2K dual 32-bit timer unit (TIMER0/TIMER1). SP804-style: each
  unit contains two independent 16/32-bit countdown sub-timers that
  share one PLIC interrupt. The counter driver exposes the two
  sub-timers as two alarm channels; the count value is a 32-bit
  count-up value wrapping every 2^32 ticks (pclk ticks of sub-timer 1).

compatible: "agm,agrv2k-timer"

include: base.yaml

properties:
  reg:
    required: true

  interrupts:
    required: true

  clocks:
    required: true
    description: |
      SYSCLK feed for this block. PBUS_DIVIDER resets to 0, so pclk == SYSCLK:
      reference the board's clk0 fixed-clock instead of copying the number --
      the driver reads it with DT_INST_PROP_BY_PHANDLE(n, clocks,
      clock_frequency), exactly like the UART and CAN drivers. A board that
      changes SYSCLK only edits &clk0.
  agm,apb-clkenable-bit:
    type: int
    required: true
    description: |
      Bit index in SYS.APB_CLKENABLE (0x03000000 + 0x60) gating this unit's
      APB clock: 14 for TIMER0, 15 for TIMER1 (SDK APB_MASK_TIMER0/1).
      The block is closed at reset and SoC bring-up opens it from here
      (soc/agm/agrv2k/soc.c) -- the driver no longer derives it from the
      register address.
    description: |
      Frequency (Hz) of the APB/PBUS clock feeding the timer core
      (the sub-timer count rate). The shipped 407 bitstream runs the timer clock at
      200 MHz (pclk == SYSCLK).
```

## dts/bindings/crc/agm,agrv2k-crc.yaml
```yaml
# Copyright (c) 2026 AgRV Contributors
# SPDX-License-Identifier: Apache-2.0

description: |
  AGM AgRV2K CRC calculation unit. The register set is
  the familiar STM32-CRC one: DR (data, 8/16/32-bit access), IDR (8-bit
  scratch), CR (poly size 7/8/16/32, input reversal byte/halfword/word,
  bit-level output reversal, endianness, RESET), INIT (seed, a write reloads
  DR) and POL (programmable polynomial, default 0x04C11DB7).

  It lives in the SYS block's *AHB* domain, not the APB one: the clock gate is
  bit 2 of SYS.AHB_CLKENABLE and the reset release is bit 2 of SYS.AHB_RESET
  (the vendor example gates it with SYS_EnableAHBClock(AHB_MASK_CRC0)). Both
  are opened by the SoC bring-up from the two properties below -- the driver
  itself never touches the SYS block.

compatible: "agm,agrv2k-crc"

include: [base.yaml]

properties:
  reg:
    required: true

  agm,ahb-clkenable-bit:
    type: int
    required: true
    enum: [2]
    description: |
      Bit index in SYS.AHB_CLKENABLE (0x03000000 + 0x70) gating CRC0's AHB
      clock. SoC bring-up opens it.

  agm,ahb-reset-bit:
    type: int
    required: true
    enum: [2]
    description: |
      Bit index in SYS.AHB_RESET (0x03000000 + 0x50) holding CRC0 in reset;
      write 1 = assert, so bring-up clears it.
```

## dts/bindings/display/agm,epd-g2.yaml
```yaml
# Copyright (c) 2026 AgRV Contributors
# SPDX-License-Identifier: Apache-2.0

title: Pervasive Displays E2xxx (G2/iTC COG) e-paper on the AgRV2K SPI engine

description: |
  Six-wire EPD front end on one of the AgRV2K SPI engines: the controller
  drives SCL (SCK), SDA (MOSI) and CSB (CSN) -- mode 0, MSB first -- while
  D/C#, RST_N and the panel's BUSY_N output are plain GPIOs. The panel's SDA
  is an input only, so the engine's MISO line is unused.

  The panel wants its chip select pulsed around *every* byte ("if register
  data is more than one byte, the CS# pulse is necessary between each data
  byte", application note "SPI Timing Format"). The AgRV2K engine asserts CSN
  for exactly one transfer, so one `spi_write()` per byte gives that framing
  without any GPIO juggling.

  Panels of this family (E2271CS091 and relatives) load their waveform from
  the driver's OTP during init and only support **full** updates: there is no
  partial/fast refresh to model here.

compatible: "agm,epd-g2"

include: [spi-device.yaml]

properties:
  dc-gpios:
    type: phandle-array
    required: true
    description: Data/command (DC) -- 0 = command, 1 = data.

  reset-gpios:
    type: phandle-array
    required: true
    description: System reset (RST_N), active low.

  busy-gpios:
    type: phandle-array
    required: true
    description: Busy output (BUSY_N) -- low means the panel is working.

  width:
    type: int
    required: true
    description: Panel width in pixels (E2271CS091 = 264).

  height:
    type: int
    required: true
    description: Panel height in pixels (E2271CS091 = 176).
```

## dts/bindings/display/agm,lcd-8080.yaml
```yaml
# Copyright (c) 2026 AgRV Contributors
# SPDX-License-Identifier: Apache-2.0

title: AgRV2K GPIO-wired 8080 (MIPI DBI type A) LCD bus

description: |
  A parallel MCU-interface panel whose bus is driven by GPIOs: the AgRV2K has
  no LCD controller, so a 16-bit 8080 bus is bit-banged from GPIO banks. Which
  physical pin each GPIO bit lands on is decided by the FPGA bitstream
  (board.ve), not by this node -- the pin map lives in the shared
  `agm,agrv2k-pins` node.

  This binding only describes the bus wiring; the panel controller's register
  init belongs to the driver/sample that consumes it. Timing is deliberately
  not modelled: the write pulse is stretched by software, so there is no
  clock rate to declare.

compatible: "agm,lcd-8080"

properties:
  data-gpios:
    type: phandle-array
    required: true
    description: |
      DB0 .. DBn-1, low bit first (16 entries for the 16-bit mode the vendor
      examples use: IM[2:0] = 110).

  cs-gpios:
    type: phandle-array
    required: true
    description: Chip select (active low).

  rs-gpios:
    type: phandle-array
    required: true
    description: Register select / DC -- 0 writes a command, 1 writes data.

  wr-gpios:
    type: phandle-array
    required: true
    description: Write strobe, active low (data is latched on the rising edge).

  rd-gpios:
    type: phandle-array
    required: true
    description: Read strobe, active low (the panel drives DB on read).

  reset-gpios:
    type: phandle-array
    required: true
    description: Panel RESET (active low).

  backlight-gpios:
    type: phandle-array
    description: BL_CTR -- the adapter's backlight enable/PWM input.
```
