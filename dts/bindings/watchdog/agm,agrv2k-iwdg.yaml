## dts/bindings/watchdog/agm,agrv2k-iwdg.yaml
```yaml
# Copyright (c) 2026 AgRV Contributors
# SPDX-License-Identifier: Apache-2.0

description: |
  AGM AgRV2K IWDG (independent watchdog) — backup-domain 16-bit register at
  RTC base + 0x34 (vendor SDK framework-agrv_sdk/src/iwdg.h + rtc.h).

  Hardware:
    * Lives in the RTC / backup domain, NOT the APB bus. No APB clock
      gate and no PLIC IRQ: the counter reset the SoC when it expires
      and that is the only reaction.
    * 8 prescaler taps (/2 /4 /8 /16 /32 /64 /128 /256) over LSI
      (internal 32 kHz) or LSE (32768 Hz crystal). LSE keeps running
      in standby; LSI drifts with temperature (~±30 % in datasheet).
    * Timeout = prescaler × vendor-fixed reload count (no user reload
      register; "feed" is the write-key 0xa000).
    * Disable semantics: writing IWDG_ENABLE = 0 stops the counter
      but leaves the rest of the backup-domain state intact. A
      subsequent enable re-uses the same prescaler / clock source /
      freeze configuration. The vendor SDK reaches for a hard reset
      only via RTC->BDRST (whole backup-domain pulse), which is not
      exposed through this driver.

  Zephyr WDT API notes:
    * callback must be NULL (no IRQ path).
    * window.min must be 0 (no windowed watchdog).
    * reset_flags must be WDT_FLAG_RESET_SOC (reset-only).
    * WDT_OPT_PAUSE_HALTED_BY_DBG returns -ENOTSUP (no debug halt
      clock stop on the backup domain).
    * WDT_OPT_PAUSE_IN_SLEEP translates to setting IWDG_STOP_FREEZE
      in the freeze mode.

compatible: "agm,agrv2k-iwdg"

include: base.yaml

properties:
  reg:
    required: true

  agm,prescaler:
    type: int
    required: true
    enum: [2, 4, 8, 16, 32, 64, 128, 256]
    description: |
      Counter prescaler divisor (SDK IWDG_ClkPrescalerTypeDef). The
      driver picks the closest supported timeout by mapping the
      requested window.max (ms) to "the smallest prescaler whose
      timeout is ≥ window.max".

  agm,clk-source:
    type: string
    required: true
    enum: ["lsi", "lse"]
    description: |
      Clock source (SDK IWDG_ClkSourceTypeDef). "lse" requires the
      board to wire a 32768 Hz crystal to the LSE pins; on boards
      without LSE, an LSE configuration will spin in
      RTC->BDCR.LSERDY and never arm the IWDG. Prefer "lsi" for
      board-agnostic bring-up.

  agm,freeze-mode:
    type: string
    required: false
    default: "stop"
    enum: ["none", "stop", "standby", "all"]
    description: |
      Which low-power modes freeze the counter (SDK
      IWDG_FreezeTypeDef). Default "stop" stops the counter in STOP
      and lets it run in STANDBY — the recommended setting when the
      IWDG is meant to wake from standby via reset.
```

## dts/bindings/watchdog/agm,agrv2k-wdt.yaml
```yaml
# Copyright (c) 2026 AgRV Contributors
# SPDX-License-Identifier: Apache-2.0

description: |
  AGM AgRV2K system watchdog (WDOG0 @ 0x40011000). SP805-style
  Arm-primecell watchdog: 32-bit down counter clocked by pclk, load
  register (0x00), control (0x08: INTEN bit0 / RESEN bit1), interrupt
  clear (0x0C — also reloads the counter) and lock register at 0xC00
  (unlock key 0x1ACCE551). PLIC IRQ 4; APB clock gate bit 1. See the
  SDK framework-agrv_sdk/src/watchdog.h.

compatible: "agm,agrv2k-wdt"

include: base.yaml

properties:
  reg:
    required: true

  interrupts:
    required: true

  clocks:
    required: true
    description: |
      SYSCLK feed for this block. PBUS_DIVIDER resets to 0, so pclk == SYSCLK:
      reference the board's clk0 fixed-clock instead of copying the number --
      the driver reads it with DT_INST_PROP_BY_PHANDLE(n, clocks,
      clock_frequency), exactly like the UART and CAN drivers. A board that
      changes SYSCLK only edits &clk0.
  agm,apb-clkenable-bit:
    type: int
    required: true
    description: |
      Bit index in SYS.APB_CLKENABLE (0x03000000 + 0x60) gating WDOG0's APB
      clock (SDK APB_MASK_WATCHDOG0 = bit 1). SoC bring-up opens it; the
      driver no longer hard-codes the bit. Note the separate
      SYS.APB_CLKSTOP register, which the driver uses for
      WDT_OPT_PAUSE_HALTED_BY_DBG -- that stays driver-side.

  clock-frequency:
    type: int
    description: |
      Frequency (Hz) of the APB/PBUS clock feeding the watchdog core
      (the WdogLoad countdown rate). pclk == SYSCLK (PBUS_DIVIDER
      reset value 0), 200 MHz on the shipped 407 bitstream.
```

## tests/drivers/can/can_agm/testcase.yaml
```yaml
# SPDX-License-Identifier: Apache-2.0

tests:
  drivers.can.can_agm.native:
    platform_allow:
      - native_sim
    tags:
      - can
      - hal_ag32
```

## tests/drivers/counter/counter_agm_gptimer/testcase.yaml
```yaml
# SPDX-License-Identifier: Apache-2.0

tests:
  drivers.counter.counter_agm_gptimer.native:
    platform_allow:
      - native_sim
    tags:
      - counter
      - hal_ag32
```

## tests/drivers/counter/counter_agm_rtc/testcase.yaml
```yaml
# SPDX-License-Identifier: Apache-2.0

tests:
  drivers.counter.counter_agm_rtc.native:
    platform_allow:
      - native_sim
    tags:
      - counter
      - hal_ag32
```

## tests/drivers/crc/crc_agm/testcase.yaml
```yaml
# SPDX-License-Identifier: Apache-2.0

tests:
  drivers.crc.crc_agm.native:
    platform_allow:
      - native_sim
    tags:
      - crc
      - hal_ag32
```

## tests/drivers/dma/dma_agm/testcase.yaml
```yaml
# SPDX-License-Identifier: Apache-2.0

tests:
  drivers.dma.dma_agm.native:
    platform_allow:
      - native_sim
    tags:
      - dma
      - hal_ag32
```

## tests/drivers/ethernet/eth_agm/testcase.yaml
```yaml
# SPDX-License-Identifier: Apache-2.0

tests:
  drivers.ethernet.eth_agm.native:
    platform_allow:
      - native_sim
    tags:
      - ethernet
      - hal_ag32
```

## tests/drivers/ethernet/mdio_agm/testcase.yaml
```yaml
# SPDX-License-Identifier: Apache-2.0

tests:
  drivers.ethernet.mdio_agm.native:
    platform_allow:
      - native_sim
    tags:
      - ethernet
      - mdio
      - hal_ag32
```

## tests/drivers/ethernet/phy_agm_lan8720/testcase.yaml
```yaml
# SPDX-License-Identifier: Apache-2.0

tests:
  drivers.ethernet.phy_agm_lan8720.native:
    platform_allow:
      - native_sim
    tags:
      - ethernet
      - phy
      - hal_ag32
```

## tests/drivers/i2c/i2c_agm/testcase.yaml
```yaml
# SPDX-License-Identifier: Apache-2.0

tests:
  drivers.i2c.i2c_agm.native:
    platform_allow:
      - native_sim
    tags:
      - i2c
      - hal_ag32
```

## tests/drivers/misc/boot_agm_bind/testcase.yaml
```yaml
# SPDX-License-Identifier: Apache-2.0

tests:
  drivers.misc.boot_agm.bind:
    platform_allow:
      - native_sim
    tags:
      - flash
      - hal_ag32
```

## tests/drivers/misc/boot_agm_ecdsa/testcase.yaml
```yaml
# SPDX-License-Identifier: Apache-2.0

tests:
  drivers.misc.boot_agm.ecdsa:
    platform_allow:
      - native_sim
    tags:
      - flash
      - hal_ag32
```

## tests/drivers/misc/boot_agm_rsa/testcase.yaml
```yaml
# SPDX-License-Identifier: Apache-2.0

tests:
  drivers.misc.boot_agm.rsa:
    platform_allow:
      - native_sim
    tags:
      - flash
      - hal_ag32
```

## tests/drivers/pwm/pwm_agm_gptimer/testcase.yaml
```yaml
# SPDX-License-Identifier: Apache-2.0

tests:
  drivers.pwm.pwm_agm_gptimer.native:
    platform_allow:
      - native_sim
    tags:
      - pwm
      - hal_ag32
```

## tests/drivers/serial/uart_agm/testcase.yaml
```yaml
# SPDX-License-Identifier: Apache-2.0

tests:
  drivers.serial.uart_agm.native:
    platform_allow:
      - native_sim
    tags:
      - uart
      - hal_ag32
```

## tests/drivers/usb/udc/udc_agm/testcase.yaml
```yaml
# SPDX-License-Identifier: Apache-2.0

tests:
  drivers.usb.udc.udc_agm.native:
    platform_allow:
      - native_sim
    tags:
      - usb
      - hal_ag32
```

## tests/drivers/watchdog/wdt_agm/testcase.yaml
```yaml
# SPDX-License-Identifier: Apache-2.0

tests:
  drivers.watchdog.wdt_agm.native:
    platform_allow:
      - native_sim
    tags:
      - watchdog
      - hal_ag32
```

## tests/soc/agm/fcb_lzw/testcase.yaml
```yaml
# SPDX-License-Identifier: Apache-2.0

tests:
  soc.agm.fcb_lzw:
    platform_allow:
      - native_sim
    tags:
      - hal_ag32
```
