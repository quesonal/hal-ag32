/* SPDX-License-Identifier: Apache-2.0 */
/*
 * AUTO-GENERATED by tools/generate_pinctrl_dtsi.py -- DO NOT EDIT.
 * Re-run it after changing the pin list or the AF table.
 *
 * Source dts : ../../../tmp/b_slave_spi/zephyr/zephyr.dts
 * AF table   : tools/agm_af_pins.yaml
 * Pin list   : samples/slave_spi/boards/agrv2k_407.overlay
 * Bitstream  : vendor AgRV_pio examples/spi/slave_spi, its own top.ve (100 MHz)
 */

#include <zephyr/dt-bindings/pinctrl/agm-agrv2k-pinctrl.h>

&spi0_default {
	agm,pins =
		<AGM_PINCTRL(4, 6, AGM_PINCTRL_OUTPUT)>,
		<AGM_PINCTRL(4, 5, AGM_PINCTRL_OUTPUT)>,
		<AGM_PINCTRL(0, 0, AGM_PINCTRL_OUTPUT)>,
		<AGM_PINCTRL(0, 1, AGM_PINCTRL_NO_DIR)>;
};

&spi1_default {
	agm,pins =
		<AGM_PINCTRL(5, 0, AGM_PINCTRL_OUTPUT)>,
		<AGM_PINCTRL(4, 7, AGM_PINCTRL_OUTPUT)>,
		<AGM_PINCTRL(0, 4, AGM_PINCTRL_OUTPUT)>,
		<AGM_PINCTRL(0, 5, AGM_PINCTRL_NO_DIR)>;
};
