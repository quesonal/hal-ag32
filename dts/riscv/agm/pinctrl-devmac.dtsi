/* SPDX-License-Identifier: Apache-2.0 */
/*
 * AUTO-GENERATED by tools/generate_pinctrl_dtsi.py -- DO NOT EDIT.
 * Re-run it after changing the pin list or the AF table.
 *
 * Source dts : ../../../tmp/b_pins3/zephyr/zephyr.dts
 * AF table   : tools/agm_af_pins.yaml
 * Pin list   : samples/lan8720_{link,iperf,udp_direct}/boards/agrv2k_407.overlay
 * Bitstream  : <your canonical bitstream> (md5 6378549f3a8f82dd386353077f3d4a02)
 */

#include <zephyr/dt-bindings/pinctrl/agm-agrv2k-pinctrl.h>

&eth0_default {
	agm,pins =
		<AGM_PINCTRL(7, 7, AGM_PINCTRL_NO_DIR)>,
		<AGM_PINCTRL(8, 0, AGM_PINCTRL_NO_DIR)>,
		<AGM_PINCTRL(9, 1, AGM_PINCTRL_OUTPUT)>,
		<AGM_PINCTRL(9, 2, AGM_PINCTRL_OUTPUT)>,
		<AGM_PINCTRL(9, 5, AGM_PINCTRL_OUTPUT)>,
		<AGM_PINCTRL(8, 5, AGM_PINCTRL_NO_DIR)>,
		<AGM_PINCTRL(7, 5, AGM_PINCTRL_NO_DIR)>,
		<AGM_PINCTRL(9, 7, AGM_PINCTRL_OUTPUT)>,
		<AGM_PINCTRL(4, 0, AGM_PINCTRL_OUTPUT)>,
		<AGM_PINCTRL(4, 0, AGM_PINCTRL_INPUT)>;
};

&uart0_default {
	agm,pins =
		<AGM_PINCTRL(6, 1, AGM_PINCTRL_INPUT)>,
		<AGM_PINCTRL(7, 6, AGM_PINCTRL_OUTPUT)>;
};
